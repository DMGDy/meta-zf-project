## conf/bblayers.conf
```bitbake
LCONF_VERSION = "1"

BBPATH := "${TOPDIR}}"
BBFILES := ""

BBLAYERS = " \
    ${TOPDIR}/meta/ \
    ${TOPDIR}/meta-st-stm32mp/ \
    ${TOPDIR}/meta-openembedded/meta-multimedia \
    ${TOPDIR}/meta-openembedded/meta-networking \
    ${TOPDIR}/meta-openembedded/meta-webserver \
    "
```

## conf/distro/zf-embedded-linux.conf
```bitbake
DISTRO = "zf-embedded-linux"
DISTRO_CODENAME = "early-test"
DISTRO_NAME = "ZF Embedded Linux"

DISTRO_FEATURES:append = " systemd"
DISTRO_VERSION = "0.0.2"
VIRTUAL-RUNTIME_init_manager = "systemd"

PREFERRED_PROVIDER_virtual/kernel = "linux-stm32mp"

CORE_IMAGE_EXTRA_INSTALL += "systemd-extra-utils"
PACKAGECONFIG:append:pn-networkmanager = " systemd"

PREFERRED_VERSION_rust = "1.78.0"
PREFERRED_VERSION_rust-cross = "1.78.0"
PREFERRED_VERSION_rust-llvm = "1.78.0"
PREFERRED_VERSION_rust-llvm-dev = "1.78.0"

RUST_TARGET_SYS:append = " wasm32-unknown-unknown"

PREFERRED_VERSION_cargo-bin-native = "1.78.0"
PREFERRED_VERSION_cargo-bin = "1.78.0"
PREFERRED_VERSION_cargo-bin-native = "1.78.0"
PREFERRED_VERSION_cargo-bin-dev = "1.78.0"

PREFERRED_VERSION_python3 = "3.10%"
PREFERRED_VERSION_python3-native = "3.10%"
PREFERRED_VERSION_python3-nativesdk = "3.10%"
PREFERRED_VERSION_nativesdk-rust = "1.78.0"

PREFERRED_PROVIDER_virtual/rustc = "rust-native"
PREFERRED_PROVIDER_virtual/rust-native = "rust-native"
PREFERRED_VERSION_llvm-native = "13.01"

TOOLCHAIN_HOST_TASK:append = " nativesdk-rust"

ASSUME_PROVIDED += "nativesdk-rust"
```

## conf/layer.conf
```bitbake
# We have a conf and classes directory, add to BBPATH
BBPATH .= ":${LAYERDIR}"

# We have recipes-* directories, add to BBFILES
BBFILES += "${LAYERDIR}/recipes-*/*/*.bb \
            ${LAYERDIR}/recipes-*/*/*.bbappend"

BBFILE_COLLECTIONS += "zf-project"

BBFILE_PATTERN_zf-project = "^${LAYERDIR}/"
BBFILE_PRIORITY_zf-project = "6"

LAYERDEPENDS_zf-project = "core \
                           webserver \
                           networking-layer \
                           multimedia-layer \
                           rust-bin-layer \
                           clang-layer \
                           "



LAYERSERIES_COMPAT_zf-project = "kirkstone"
```

## conf/machine/stm32mp1.conf
```bitbake
MACHINE_FEATURES += "wifi"
MACHINE_FEATURES += "m4copro"

WIFI_LIST += "linux-firmware-bcm43430"
```

## conf/machine/stm32mp15-disco.conf
```bitbake
MACHINE_FEATURES += "wifi"
MACHINE_FEATURES += "m4copro"
MACHINE_FEATURES:remove = "screen"
MACHINE_FEATURES:remove = "alsa"
MACHINE_FEATURES:remove = "blutooth"
MACHINE_FEATURES:remove = "splashscreen"


WIFI_LIST += "linux-firmware-bcm43430"
```
